## base_external/Config.in
```kconfig
source "$BR2_EXTERNAL_project_base_PATH/package/i2c-soil-drv/Config.in"
source "$BR2_EXTERNAL_project_base_PATH/package/soil-mon-app/Config.in"
```

## base_external/package/i2c-soil-drv/Config.in
```kconfig
config BR2_PACKAGE_I2C_SOIL_DRV
	bool "i2c-soil-drv"
	depends on BR2_LINUX_KERNEL
	help
	  i2c-soil-drv driver for i2c soil moisture sensor
```

## base_external/package/soil-mon-app/Config.in
```kconfig
config BR2_PACKAGE_SOIL_MON_APP
	bool "soil-mon-app"
	depends on BR2_PACKAGE_I2C_SOIL_DRV
	help
	  soil-mon-app application for soil moisture monitoring and watering
```
